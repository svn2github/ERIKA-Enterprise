; script used to load t32_jobs.cmm.
; DO NOT MODIFY this script. Modify common/e200z7/t32_quit.cmm instead

area
area.create Messages
area.view Messages

do t32_jobs.cmm

area.select Messages
print
print
print "Done."
print "-------------------------------------------------------"
print "-------------------------------------------------------"
print "-------------------------------------------------------"
print "-------------------------------------------------------"
area.select A000

